## arch/arm/mach-s5pc1xx/Kconfig
```kconfig
if ARCH_S5PC1XX

choice
	prompt "S5PC1XX board select"
	optional

config TARGET_S5P_GONI
	bool "S5P Goni board"
	select OF_CONTROL

config TARGET_SMDKC100
	bool "Support smdkc100 board"
	select OF_CONTROL

config TARGET_TINY210
	bool "Support tiny210 board"
	select OF_CONTROL
	select SUPPORT_SPL

endchoice

config SYS_SOC
	default "s5pc1xx"

source "board/samsung/goni/Kconfig"
source "board/samsung/smdkc100/Kconfig"
source "board/samsung/tiny210/Kconfig"

endif
```

## board/samsung/tiny210/Kconfig
```kconfig
if TARGET_TINY210

config SYS_BOARD
	default "tiny210"

config SYS_VENDOR
	default "samsung"

config SYS_SOC
	default "s5pv2xx"

config SYS_CONFIG_NAME
	default "tiny210"

endif
```
